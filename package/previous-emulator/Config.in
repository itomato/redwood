## package/previous-emulator/Config.in
```kconfig
config BR2_PACKAGE_PREV
	bool "previous-emulator"
	depends on !BR2_STATIC_LIBS
	help

	Previous is a Next computer hardware emulator.
        It aims to emulate a Next Cube or a Next Station with all its peripherals.

	http://previous.alternative-system.com

if BR2_PACKAGE_PREV

config BR2_PACKAGE_PREV_DIRECTFB
	bool "DirectFB video driver"
	depends on BR2_PACKAGE_DIRECTFB

comment "DirectFB video driver needs directfb"
	depends on !BR2_PACKAGE_DIRECTFB

config BR2_PACKAGE_PREV_OPENGL
	bool "OpenGL (GLX)"
	depends on BR2_PACKAGE_HAS_LIBGL
	depends on BR2_PACKAGE_XORG7
	depends on BR2_USE_MMU # X11 video driver
	select BR2_PACKAGE_PREV_X11

comment "OpenGL support needs X11 and an OpenGL provider"
	depends on BR2_USE_MMU
	depends on !BR2_PACKAGE_HAS_LIBGL || !BR2_PACKAGE_XORG7

config BR2_PACKAGE_PREV_OPENGLES
	bool "OpenGL ES"
	depends on BR2_PACKAGE_HAS_LIBGLES

comment "OpenGL ES support needs an OpenGL ES provider"
	depends on !BR2_PACKAGE_HAS_LIBGLES

endif

comment "previous needs a toolchain w/ dynamic library"
	depends on BR2_STATIC_LIBS
```

## package/windowmaker/Config.in
```kconfig
config BR2_PACKAGE_WINDOWMAKER
	bool "windowmaker"
	depends on BR2_PACKAGE_XORG7
	depends on BR2_INSTALL_LIBSTDCPP
	depends on BR2_USE_MMU # fork()
	select BR2_PACKAGE_XLIB_LIBX11
	help
	  Your NeXT Window Manager

	  http://windowmaker.info

comment "wmaker needs a toolchain w/ C++"
	depends on BR2_USE_MMU
	depends on BR2_PACKAGE_XORG7 && !BR2_INSTALL_LIBSTDCPP
```
